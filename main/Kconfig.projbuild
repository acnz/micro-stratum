## main/Kconfig.projbuild
```kconfig
menu "Micro-Stratum Configuration"

    config WIFI_SSID
        string "WiFi SSID"
        default "MeuWiFi"
        help
            Nome da rede WiFi para conectar.

    config WIFI_PASSWORD
        string "WiFi Password"
        default "minhasenha"
        help
            Senha da rede WiFi.

    config BTC_ADDRESS
        string "Bitcoin Wallet Address"
        default "1A1zP1eP5QGefi2DMPTfTL5SLmv7DivfNa"
        help
            Seu endereço de doação ou mineração.

    config POOL_URL
        string "Pool url"
        default "pool.nerdminer.io"
        help
            Endereço da pool de mineração.

    config POOL_PORT
        int "Pool port"
        default 3333
        help
            Porta da pool de mineração.

    config WORKER_NAME
        string "Worker Name"
        default "MS-minis3"
        help
            Nome do worker na pool.

    config UART_PORT_NUM
        int "UART port number"
        range 0 1
        default 1
        help
            UART communication port number for the example.
            See UART documentation for available port numbers.

    config UART_RXD
        int "UART RXD pin number"
        default 5
        help
            GPIO number for UART RX pin. See UART documentation for more information
            about available pin numbers for UART.

    config UART_TXD
        int "UART TXD pin number"
        default 4
        help
            GPIO number for UART TX pin. See UART documentation for more information
            about available pin numbers for UART.

endmenu
```
